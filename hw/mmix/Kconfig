## hw/mmix/Kconfig
```kconfig
config MMIX_VIRT
    bool
    default y
    depends on MMIX
    select DEVICE_TREE
    select SERIAL_MM
    select FRAMEBUFFER
    select GOLDFISH_RTC
    select PCI_EXPRESS_GENERIC_BRIDGE
    select PFLASH_CFI01
    select VIRT_CTRL
    select VIRTIO_MMIO
    select WDT_SBSA
```
